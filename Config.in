## Config.in
```kconfig
menu "Avaota-F1 packages"

source "$BR2_EXTERNAL_AVAOTAF1_PATH/package/v821-firmware/Config.in"
source "$BR2_EXTERNAL_AVAOTAF1_PATH/package/v821-wifimanager/Config.in"

endmenu
```

## configs/avaota_f1_defconfig
```kconfig
BR2_riscv=y
BR2_riscv_g=y
BR2_RISCV_32=y
BR2_RISCV_ISA_RVC=y
BR2_RISCV_ABI_ILP32D=y
BR2_TOOLCHAIN_BUILDROOT=y
BR2_TOOLCHAIN_BUILDROOT_GLIBC=y
BR2_KERNEL_HEADERS_AS_KERNEL=y
BR2_TARGET_GENERIC_HOSTNAME="avaota-f1"
BR2_TARGET_GENERIC_ISSUE="Avaota-F1 / Allwinner V821"
BR2_TARGET_GENERIC_GETTY=y
BR2_TARGET_GENERIC_GETTY_PORT="ttyS0"
BR2_TARGET_GENERIC_GETTY_BAUDRATE_115200=y
BR2_ROOTFS_OVERLAY="$(BR2_EXTERNAL_AVAOTAF1_PATH)/board/avaota-f1/rootfs-overlay"
BR2_ROOTFS_POST_BUILD_SCRIPT="$(BR2_EXTERNAL_AVAOTAF1_PATH)/board/avaota-f1/post-build.sh"
BR2_ROOTFS_POST_IMAGE_SCRIPT="$(BR2_EXTERNAL_AVAOTAF1_PATH)/board/avaota-f1/post-image.sh"
BR2_LINUX_KERNEL=y
BR2_LINUX_KERNEL_CUSTOM_GIT=y
BR2_LINUX_KERNEL_CUSTOM_REPO_URL="file://$(BR2_EXTERNAL_AVAOTAF1_PATH)/../linux-v821"
BR2_LINUX_KERNEL_CUSTOM_REPO_VERSION="eb1ec223c0a3d1344029dfb1078748a010a0cba0"
BR2_LINUX_KERNEL_USE_CUSTOM_CONFIG=y
BR2_LINUX_KERNEL_CUSTOM_CONFIG_FILE="$(BR2_EXTERNAL_AVAOTAF1_PATH)/../linux-v821/configs/avaota_f1_defconfig"
BR2_PACKAGE_HOST_LINUX_HEADERS_CUSTOM_5_4=y
BR2_LINUX_KERNEL_IMAGEGZ=y
BR2_LINUX_KERNEL_DTS_SUPPORT=y
BR2_LINUX_KERNEL_INTREE_DTS_NAME="avaota-f1"
BR2_PACKAGE_V821_FIRMWARE=y
BR2_PACKAGE_V821_WIFIMANAGER=y
BR2_TARGET_ROOTFS_SQUASHFS=y
BR2_TARGET_ROOTFS_SQUASHFS_BS_128K=y
BR2_TARGET_ROOTFS_SQUASHFS4_XZ=y
# BR2_TARGET_ROOTFS_TAR is not set
```

## package/v821-firmware/Config.in
```kconfig
config BR2_PACKAGE_V821_FIRMWARE
	bool "V821 remote-core and wireless firmware"
	help
	  Install the V821 E907 remote-core image and V821/V821B WLAN/FMAC
	  runtime firmware exported from the vendor BSP. The files are copied
	  into /lib/firmware in the target root filesystem.
```

## package/v821-wifimanager/Config.in
```kconfig
config BR2_PACKAGE_V821_WIFIMANAGER
	bool "V821 XRLINK Wi-Fi manager"
	select BR2_PACKAGE_V821_FIRMWARE
	help
	  Build the V821 FMAC user-space manager used by the Avaota-F1 Tina
	  configuration. This is the XRLINK STA/AP path, not cfg80211 or the
	  generic wpa_supplicant path. It installs wifi_daemon and wifi.
```
